// SpaceInvaders.c
// Runs on LM4F120/TM4C123
// Jonathan Valvano and Daniel Valvano
// This is a starter project for the edX Lab 15
// In order for other students to play your game
// 1) You must leave the hardware configuration as defined
// 2) You must not add/remove any files from the project
// 3) You must add your code only this this C file
// I.e., if you wish to use code from sprite.c or sound.c, move that code in this file
// 4) It must compile with the 32k limit of the free Keil

// This virtual Nokia project only runs on the real board, this project cannot be simulated
// Instead of having a real Nokia, this driver sends Nokia
//   commands out the UART to TExaSdisplay
// The Nokia5110 is 48x84 black and white
// pixel LCD to display text, images, or other information.

// April 19, 2014
// http://www.spaceinvaders.de/
// sounds at http://www.classicgaming.cc/classics/spaceinvaders/sounds.php
// http://www.classicgaming.cc/classics/spaceinvaders/playguide.php
/* This example accompanies the books
   "Embedded Systems: Real Time Interfacing to Arm Cortex M Microcontrollers",
   ISBN: 978-1463590154, Jonathan Valvano, copyright (c) 2013

   "Embedded Systems: Introduction to Arm Cortex M Microcontrollers",
   ISBN: 978-1469998749, Jonathan Valvano, copyright (c) 2013

 Copyright 2014 by Jonathan W. Valvano, valvano@mail.utexas.edu
    You may use, edit, run or distribute this file
    as long as the above copyright notice remains
 THIS SOFTWARE IS PROVIDED "AS IS".  NO WARRANTIES, WHETHER EXPRESS, IMPLIED
 OR STATUTORY, INCLUDING, BUT NOT LIMITED TO, IMPLIED WARRANTIES OF
 MERCHANTABILITY AND FITNESS FOR A PARTICULAR PURPOSE APPLY TO THIS SOFTWARE.
 VALVANO SHALL NOT, IN ANY CIRCUMSTANCES, BE LIABLE FOR SPECIAL, INCIDENTAL,
 OR CONSEQUENTIAL DAMAGES, FOR ANY REASON WHATSOEVER.
 For more information about my classes, my research, and my books, see
 http://users.ece.utexas.edu/~valvano/
 */
// ******* Required Hardware I/O connections*******************
// PA1, PA0 UART0 connected to PC through USB cable
// Slide pot pin 1 connected to ground
// Slide pot pin 2 connected to PE2/AIN1
// Slide pot pin 3 connected to +3.3V 
// fire button connected to PE0
// special weapon fire button connected to PE1
// 8*R resistor DAC bit 0 on PB0 (least significant bit)
// 4*R resistor DAC bit 1 on PB1
// 2*R resistor DAC bit 2 on PB2
// 1*R resistor DAC bit 3 on PB3 (most significant bit)
// LED on PB4
// LED on PB5

#include "..//tm4c123gh6pm.h"
#include "Nokia5110.h"
#include "Random.h"
#include "TExaS.h"
#include "Sprite.h"
void PortE_Init(void);
void winner(void);
void PortF_Init(void);
void DisableInterrupts(void); // Disable interrupts
void EnableInterrupts(void);  // Enable interrupts
void Timer2_Init(unsigned long period);
void Delay100ms(unsigned long count); // time delay in 0.1 seconds
void Delay100msd(unsigned long count); // time delay in 0.1 seconds

unsigned long TimerCount;
unsigned long Semaphore;

#define GPIO_PORTF_DATA_R       (*((volatile unsigned long *)0x400253FC))
#define GPIO_PORTF_DIR_R        (*((volatile unsigned long *)0x40025400))
#define GPIO_PORTF_AFSEL_R      (*((volatile unsigned long *)0x40025420))
#define GPIO_PORTF_PUR_R        (*((volatile unsigned long *)0x40025510))
#define GPIO_PORTF_DEN_R        (*((volatile unsigned long *)0x4002551C))
#define GPIO_PORTF_LOCK_R       (*((volatile unsigned long *)0x40025520))
#define GPIO_PORTF_CR_R         (*((volatile unsigned long *)0x40025524))
#define GPIO_PORTF_AMSEL_R      (*((volatile unsigned long *)0x40025528))
#define GPIO_PORTF_PCTL_R       (*((volatile unsigned long *)0x4002552C))
#define SYSCTL_RCGC2_R          (*((volatile unsigned long *)0x400FE108))

// 2. Declarations Section
//   Global Variables
unsigned long SW1,SW2;  // input from PF4,PF0
unsigned long Out;      // outputs to PF3,PF2,PF1 (multicolor LED)

// *************************** Images ***************************
const unsigned char Logo[] ={
 0x42, 0x4D, 0x06, 0x08, 0x00, 0x00, 0x00, 0x00, 0x00, 0x00, 0x76, 0x00, 0x00, 0x00, 0x28, 0x00, 0x00, 0x00, 0x54, 0x00, 0x00, 0x00, 0x2C, 0x00, 0x00, 0x00, 0x01, 0x00, 0x04, 0x00, 0x00, 0x00,
 0x00, 0x00, 0x90, 0x07, 0x00, 0x00, 0xC4, 0x0E, 0x00, 0x00, 0xC4, 0x0E, 0x00, 0x00, 0x00, 0x00, 0x00, 0x00, 0x00, 0x00, 0x00, 0x00, 0x00, 0x00, 0x00, 0x00, 0x00, 0x00, 0x80, 0x00, 0x00, 0x80,
 0x00, 0x00, 0x00, 0x80, 0x80, 0x00, 0x80, 0x00, 0x00, 0x00, 0x80, 0x00, 0x80, 0x00, 0x80, 0x80, 0x00, 0x00, 0x80, 0x80, 0x80, 0x00, 0xC0, 0xC0, 0xC0, 0x00, 0x00, 0x00, 0xFF, 0x00, 0x00, 0xFF,
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 0xFF, 0xFF, 0xFF, 0xFF, 0x00, 0x00, 0xFF,

};




// enemy ship that starts at the top of the screen (arms/mouth closed)
// width=18 x height=8
const unsigned char other_racer[] = {
  0x42, 0x4D, 0xD6, 0x00, 0x00, 0x00, 0x00, 0x00, 0x00, 0x00, 0x76, 0x00, 0x00, 0x00, 0x28, 0x00, 0x00, 0x00, 0x12, 0x00, 0x00, 0x00, 0x08, 0x00, 0x00, 0x00, 0x01, 0x00, 0x04, 0x00, 0x00, 0x00,
 0x00, 0x00, 0x60, 0x00, 0x00, 0x00, 0xC4, 0x0E, 0x00, 0x00, 0xC4, 0x0E, 0x00, 0x00, 0x00, 0x00, 0x00, 0x00, 0x00, 0x00, 0x00, 0x00, 0x00, 0x00, 0x00, 0x00, 0x00, 0x00, 0x80, 0x00, 0x00, 0x80,
 0x00, 0x00, 0x00, 0x80, 0x80, 0x00, 0x80, 0x00, 0x00, 0x00, 0x80, 0x00, 0x80, 0x00, 0x80, 0x80, 0x00, 0x00, 0x80, 0x80, 0x80, 0x00, 0xC0, 0xC0, 0xC0, 0x00, 0x00, 0x00, 0xFF, 0x00, 0x00, 0xFF,
 0x00, 0x00, 0x00, 0xFF, 0xFF, 0x00, 0xFF, 0x00, 0x00, 0x00, 0xFF, 0x00, 0xFF, 0x00, 0xFF, 0xFF, 0x00, 0x00, 0xFF, 0xFF, 0xFF, 0x00, 0x00, 0xAA, 0xAA, 0xAA, 0xAA, 0xAA, 0xAA, 0xAA, 0x00, 0x00,
 0x00, 0x00, 0x00, 0xAA, 0xAA, 0xAA, 0xAA, 0xAA, 0xAA, 0xAA, 0x00, 0x00, 0x00, 0x00, 0x00, 0x0A, 0xAA, 0xAA, 0xAA, 0xAA, 0xAA, 0xA0, 0x00, 0x00, 0x00, 0x00, 0x00, 0x00, 0x00, 0x0A, 0xAA, 0xA0,
 0x00, 0x00, 0x00, 0x00, 0x00, 0x00, 0xF0, 0x00, 0x00, 0x0A, 0xAA, 0xA0, 0x00, 0x00, 0x00, 0x00, 0x00, 0x00, 0x00, 0x0A, 0xAA, 0xAA, 0xAA, 0xAA, 0xAA, 0xA0, 0x00, 0x00, 0x00, 0x00, 0x00, 0xAA,
 0xAA, 0xAA, 0xAA, 0xAA, 0xAA, 0xAA, 0x00, 0x00, 0x00, 0x00, 0x00, 0xAA, 0xAA, 0xAA, 0xAA, 0xAA, 0xAA, 0xAA, 0x00, 0x00, 0x00, 0x00, 0xFF,

};




// image of the player's ship
// includes two blacked out columns on the left and right sides of the image to prevent smearing when moved 2 pixels to the left or right
// width=18 x height=8
const unsigned char racer[] = {
 0x42, 0x4D, 0xE2, 0x00, 0x00, 0x00, 0x00, 0x00, 0x00, 0x00, 0x76, 0x00, 0x00, 0x00, 0x28, 0x00, 0x00, 0x00, 0x12, 0x00, 0x00, 0x00, 0x09, 0x00, 0x00, 0x00, 0x01, 0x00, 0x04, 0x00, 0x00, 0x00,
 0x00, 0x00, 0x6C, 0x00, 0x00, 0x00, 0xC4, 0x0E, 0x00, 0x00, 0xC4, 0x0E, 0x00, 0x00, 0x00, 0x00, 0x00, 0x00, 0x00, 0x00, 0x00, 0x00, 0x00, 0x00, 0x00, 0x00, 0x00, 0x00, 0x80, 0x00, 0x00, 0x80,
 0x00, 0x00, 0x00, 0x80, 0x80, 0x00, 0x80, 0x00, 0x00, 0x00, 0x80, 0x00, 0x80, 0x00, 0x80, 0x80, 0x00, 0x00, 0x80, 0x80, 0x80, 0x00, 0xC0, 0xC0, 0xC0, 0x00, 0x00, 0x00, 0xFF, 0x00, 0x00, 0xFF,
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 0x00, 0x00, 0xFF,

};



// small explosion best used for the demise of an enemy
// width=16 x height=10
const unsigned char SmallExplosion0[] = {
 0x42, 0x4D, 0xC6, 0x00, 0x00, 0x00, 0x00, 0x00, 0x00, 0x00, 0x76, 0x00, 0x00, 0x00, 0x28, 0x00, 0x00, 0x00, 0x10, 0x00, 0x00, 0x00, 0x0A, 0x00, 0x00, 0x00, 0x01, 0x00, 0x04, 0x00, 0x00, 0x00,
 0x00, 0x00, 0x50, 0x00, 0x00, 0x00, 0x00, 0x00, 0x00, 0x00, 0x00, 0x00, 0x00, 0x00, 0x00, 0x00, 0x00, 0x00, 0x00, 0x00, 0x00, 0x00, 0x00, 0x00, 0x00, 0x00, 0x00, 0x00, 0x80, 0x00, 0x00, 0x80,
 0x00, 0x00, 0x00, 0x80, 0x80, 0x00, 0x80, 0x00, 0x00, 0x00, 0x80, 0x00, 0x80, 0x00, 0x80, 0x80, 0x00, 0x00, 0x80, 0x80, 0x80, 0x00, 0xC0, 0xC0, 0xC0, 0x00, 0x00, 0x00, 0xFF, 0x00, 0x00, 0xFF,
 0x00, 0x00, 0x00, 0xFF, 0xFF, 0x00, 0xFF, 0x00, 0x00, 0x00, 0xFF, 0x00, 0xFF, 0x00, 0xFF, 0xFF, 0x00, 0x00, 0xFF, 0xFF, 0xFF, 0x00, 0x00, 0x00, 0x00, 0x00, 0x00, 0x00, 0x00, 0x00, 0x00, 0xF0,
 0x0F, 0x00, 0x0F, 0x00, 0xF0, 0x00, 0x00, 0x0F, 0x00, 0xF0, 0xF0, 0x0F, 0x00, 0x00, 0x00, 0x00, 0xF0, 0x00, 0x00, 0xF0, 0x00, 0x00, 0x0F, 0xF0, 0x00, 0x00, 0x00, 0x00, 0xFF, 0x00, 0x00, 0x00,
 0xF0, 0x00, 0x00, 0xF0, 0x00, 0x00, 0x00, 0x0F, 0x00, 0x00, 0x00, 0x0F, 0x00, 0x00, 0x00, 0xF0, 0x00, 0xF0, 0xF0, 0x00, 0xF0, 0x00, 0x00, 0x00, 0x0F, 0x00, 0x0F, 0x00, 0x00, 0x00, 0x00, 0x00,
 0x00, 0x00, 0x00, 0x00, 0x00, 0x00, 0xFF};

// blank space following the small explosion for the demise of an enemy
// width=16 x height=10
const unsigned char SmallExplosion1[] = {
 0x42, 0x4D, 0xC6, 0x00, 0x00, 0x00, 0x00, 0x00, 0x00, 0x00, 0x76, 0x00, 0x00, 0x00, 0x28, 0x00, 0x00, 0x00, 0x10, 0x00, 0x00, 0x00, 0x0A, 0x00, 0x00, 0x00, 0x01, 0x00, 0x04, 0x00, 0x00, 0x00,
 0x00, 0x00, 0x50, 0x00, 0x00, 0x00, 0x00, 0x00, 0x00, 0x00, 0x00, 0x00, 0x00, 0x00, 0x00, 0x00, 0x00, 0x00, 0x00, 0x00, 0x00, 0x00, 0x00, 0x00, 0x00, 0x00, 0x00, 0x00, 0x80, 0x00, 0x00, 0x80,
 0x00, 0x00, 0x00, 0x80, 0x80, 0x00, 0x80, 0x00, 0x00, 0x00, 0x80, 0x00, 0x80, 0x00, 0x80, 0x80, 0x00, 0x00, 0x80, 0x80, 0x80, 0x00, 0xC0, 0xC0, 0xC0, 0x00, 0x00, 0x00, 0xFF, 0x00, 0x00, 0xFF,
 0x00, 0x00, 0x00, 0xFF, 0xFF, 0x00, 0xFF, 0x00, 0x00, 0x00, 0xFF, 0x00, 0xFF, 0x00, 0xFF, 0xFF, 0x00, 0x00, 0xFF, 0xFF, 0xFF, 0x00, 0x00, 0x00, 0x00, 0x00, 0x00, 0x00, 0x00, 0x00, 0x00, 0x00,
 0x00, 0x00, 0x00, 0x00, 0x00, 0x00, 0x00, 0x00, 0x00, 0x00, 0x00, 0x00, 0x00, 0x00, 0x00, 0x00, 0x00, 0x00, 0x00, 0x00, 0x00, 0x00, 0x00, 0x00, 0x00, 0x00, 0x00, 0x00, 0x00, 0x00, 0x00, 0x00,
 0x00, 0x00, 0x00, 0x00, 0x00, 0x00, 0x00, 0x00, 0x00, 0x00, 0x00, 0x00, 0x00, 0x00, 0x00, 0x00, 0x00, 0x00, 0x00, 0x00, 0x00, 0x00, 0x00, 0x00, 0x00, 0x00, 0x00, 0x00, 0x00, 0x00, 0x00, 0x00,
 0x00, 0x00, 0x00, 0x00, 0x00, 0x00, 0xFF};

// *************************** Capture image dimensions out of BMP**********

/*********PortE********/


 #define GPIO_PORTE_DATA_R       (*((volatile unsigned long *)0x400243FC))
 #define GPIO_PORTE_DIR_R        (*((volatile unsigned long *)0x40024400))
 #define GPIO_PORTE_AFSEL_R      (*((volatile unsigned long *)0x40024420))
 #define GPIO_PORTE_PUR_R        (*((volatile unsigned long *)0x40024510))
 #define GPIO_PORTE_DEN_R        (*((volatile unsigned long *)0x4002451C))
 #define GPIO_PORTE_AMSEL_R      (*((volatile unsigned long *)0x40024528))
 #define GPIO_PORTE_PCTL_R       (*((volatile unsigned long *)0x4002452C))


#define MISSILEW    ((unsigned char)Missile0[18])
#define MISSILEH    ((unsigned char)Missile0[22])
#define RACERW     ((unsigned char)racer[18])
#define RACERH     ((unsigned char)racer[22])

typedef struct racer{
  unsigned long x;      // x coordinate
  unsigned long y;      // y coordinate
	unsigned long vx;      // x coordinate
  const unsigned char *image[2]; // two pointers to images  
  long life;            // 0=dead, 1=alive
} racer_sprite;         

typedef struct other_racer{
  unsigned long x;      // x coordinate
  unsigned long y;      // y coordinate

  const unsigned char *image[2]; // two pointers to images  
  long life;            // 0=dead, 1=alive
} other_racer_sprite;         

static other_racer_sprite racer2[3];
static racer_sprite racer1;


	 void Init_racer1(void){ 
	  int i;
    racer1.x = 0;
    racer1.y = 15;
    racer1.image[0] =  racer;
    racer1.image[1] =  SmallExplosion0;
    racer1.life = 1;
   }
    void Init_racer2(void){ 
	  int i , y1 =0;
		for(i = 0 ; i < 3 ; i++){
    racer2[i].x = 47;
    racer2[i].y = y1+14;
		y1 = y1 + 14;	
    racer2[i].image[0] =  other_racer;
    racer2[i].image[1] =  SmallExplosion0;
    racer2[i].life = 1;
	}
		
}
		
 
/*
collision
unsigned long FrameCount=0;
void Draw(void){ int i;
  Nokia5110_ClearBuffer();
  for(i=0;i<4;i++){
    if(Enemy[i].life > 0){
     Nokia5110_PrintBMP(Enemy[i].x, Enemy[i].y, Enemy[i].image[FrameCount], 0);
    }000000
  }
  Nokia5110_DisplayBuffer();      // draw buffer
  FrameCount = (FrameCount+1)&0x01; // 0,1,0,1,...
}
*/

void Move_up(){
          racer1.y = racer1.y - 14 ; 
				
}
void Move_down(){
          racer1.y = racer1.y + 14; 
				  
}
	 int j = 0, i = 0 ,xpos,up_flag = 0,down_flag = 1;
int main(void){ 
  TExaS_Init(NoLCD_NoScope);  // set system clock to 80 MHz
  // you cannot use both the Scope and the virtual Nokia (both need UART0)
  Random_Init(1);
  Nokia5110_Init();
	PortF_Init();
  EnableInterrupts(); // virtual Nokia uses UART0 interrupts
	
  Nokia5110_ClearBuffer();
	Init_racer1();
	Init_racer2();
	
  Nokia5110_PrintBMP(0, 46, Logo, 0);
	Nokia5110_DisplayBuffer();  
  Delay100ms(2);              // delay 5 sec at 80 MHz

	Nokia5110_Clear();
  Nokia5110_SetCursor(1, 1);
  Nokia5110_OutString("Any Key");
  Nokia5110_SetCursor(1, 2);
  Nokia5110_OutString("To begin");
  Delay100ms(4); 
	
   SW1 = GPIO_PORTF_DATA_R&0x10;     // read PF4 into SW1
   SW2 = GPIO_PORTF_DATA_R&0x01;     // read PF0 into SW2
	 
	 if(!SW2 || !SW1){
	Nokia5110_Clear(); 
	Nokia5110_Clear();
  Nokia5110_SetCursor(1, 1);
  Nokia5110_OutString("Be");
  Nokia5110_SetCursor(1, 2);
  Nokia5110_OutString("Ready");
  Delay100ms(2);
		 
  		Nokia5110_Clear();
	   Nokia5110_ClearBuffer();
     Nokia5110_PrintBMP(0, racer1.y, racer, 0);
		 Nokia5110_DisplayBuffer();		 
		  Delay100ms(3);
	 while(1){
     		
				
				if(i==0){
					xpos = racer2[0].x;	
					//SW1 = GPIO_PORTF_DATA_R&0x11; 
		      //SW2 = GPIO_PORTF_DATA_R&0x11;
					while(xpos > 1){
					xpos  = xpos - 1.5;	
					Nokia5110_ClearBuffer();			
				  Nokia5110_PrintBMP(xpos, racer2[0].y, other_racer, 0);
          Nokia5110_PrintBMP(0, racer1.y, racer, 0);							
					Nokia5110_DisplayBuffer();	
					Delay100msd(2);	
					xpos  = xpos - 1.5;	
					Nokia5110_ClearBuffer();			
				  Nokia5110_PrintBMP(xpos, racer2[0].y, other_racer, 0);
          Nokia5110_PrintBMP(0, racer1.y, racer, 0);							
					Nokia5110_DisplayBuffer();		
					SW1 = GPIO_PORTF_DATA_R&0x10; 
		      SW2 = GPIO_PORTF_DATA_R&0x01;	
		       if(!SW1 ){
						if(up_flag == 1 && racer1.y > 14)
						{
						Move_up();
						down_flag = 1;	
						}
					 	
			   	}
         if(!SW2 ){
						if(down_flag == 1 && racer1.y <30)
						{
						Move_down();
						up_flag = 1;	
						}
					 	
			   	} 
					Nokia5110_ClearBuffer();	
					Nokia5110_PrintBMP(xpos, racer2[0].y, other_racer, 0);
					Nokia5110_PrintBMP(0, racer1.y, racer, 0);
          Nokia5110_Clear();						
				  Nokia5110_DisplayBuffer();
					Delay100msd(2);	
					} 
					i++;
					j++;
				}
					if(i==1){
					xpos = racer2[1].x;		
					//SW1 = GPIO_PORTF_DATA_R&0x11; 
		      //SW2 = GPIO_PORTF_DATA_R&0x11;
						
					while(xpos > 1){
					xpos  = xpos - 1.5;	
					Nokia5110_ClearBuffer();	
					Nokia5110_PrintBMP(xpos, racer2[1].y, other_racer, 0);
					Nokia5110_PrintBMP(0, racer1.y, racer, 0);		
				  Nokia5110_DisplayBuffer();
						Delay100msd(2);
						xpos  = xpos - 1.5;	
					Nokia5110_ClearBuffer();	
					Nokia5110_PrintBMP(xpos, racer2[1].y, other_racer, 0);
					Nokia5110_PrintBMP(0, racer1.y, racer, 0);		
				  Nokia5110_DisplayBuffer();
						
					SW1 = GPIO_PORTF_DATA_R&0x10; 
		      SW2 = GPIO_PORTF_DATA_R&0x01;							
		         if(!SW1 ){
						if(up_flag == 1 && racer1.y > 14)
						{
						Move_up();
						down_flag = 1;	
						}
					 	
			   	}
         if(!SW2 ){
						if(down_flag == 1 && racer1.y < 30)
						{
						Move_down();
						up_flag = 1;	
						}
					 	
			   	} 		 
				  Delay100msd(2);				
          Nokia5110_PrintBMP(0, racer1.y, racer, 0);	
          Nokia5110_PrintBMP(xpos, racer2[1].y, other_racer, 0);								
			    Nokia5110_Clear();	  
					Nokia5110_DisplayBuffer();		
					Delay100msd(2);		
					} 
					i++;
					j++;
				}
					if(i==2){
					xpos = racer2[2].x;
						SW1 = GPIO_PORTF_DATA_R&0x11; 
		      SW2 = GPIO_PORTF_DATA_R&0x11;
					while(xpos > 1){
					xpos  = xpos - 1.75;	
					Nokia5110_ClearBuffer();			
				  Nokia5110_PrintBMP(xpos, racer2[2].y, other_racer, 0);
          Nokia5110_PrintBMP(0, racer1.y, racer, 0);							
					Nokia5110_DisplayBuffer();	
					  Delay100msd(2);
						xpos  = xpos - 1.5;	
					Nokia5110_ClearBuffer();	
					Nokia5110_PrintBMP(xpos, racer2[2].y, other_racer, 0);
					Nokia5110_PrintBMP(0, racer1.y, racer, 0);		
				  Nokia5110_DisplayBuffer();
						
					SW1 = GPIO_PORTF_DATA_R&0x10; 
		      SW2 = GPIO_PORTF_DATA_R&0x01;	
				    if(!SW1 ){
						if(up_flag == 1 && racer1.y > 14)
						{
						Move_up();
						down_flag = 1;	
						}
					 	
			   	}
         if(!SW2 ){
						if(down_flag == 1 && racer1.y < 30)
						{
						Move_down();
						up_flag = 1;	
						}
					 	
			   	}
          if(xpos >= 7 && (racer2[2].y == racer1.y))  {				 
					Delay100msd(2);	
					Nokia5110_ClearBuffer();	
					Nokia5110_PrintBMP(xpos, racer2[2].y, other_racer, 0);
					Nokia5110_PrintBMP(0, racer1.y, racer, 0);
          Nokia5110_Clear();						
				  Nokia5110_DisplayBuffer();
					Delay100msd(2);	
					break;
					}
					Delay100msd(2);	
					Nokia5110_ClearBuffer();	
					Nokia5110_PrintBMP(xpos, racer2[2].y, other_racer, 0);
					Nokia5110_PrintBMP(0, racer1.y, racer, 0);
          Nokia5110_Clear();						
				  Nokia5110_DisplayBuffer();
					Delay100msd(2);	
					} 
           i=0;
           j++;					
				}
					if(j>5){
					  break;
					}
	   }
	  if(j>5){
	   winner();
	  }
	 else{
		   Nokia5110_Clear();
	     Nokia5110_SetCursor(1, 1);
       Nokia5110_OutString("GAME OVER");
		   Nokia5110_SetCursor(1, 3);
       Nokia5110_OutString("Nice try");
	 }
  }
	
 }



void winner(void){
	Nokia5110_Clear();
  Nokia5110_SetCursor(1, 1);
  Nokia5110_OutString("Well done");
  Nokia5110_SetCursor(1, 3);
  Nokia5110_OutString("Nice try");
  Nokia5110_SetCursor(2, 4);
  Nokia5110_SetCursor(0, 0); // renders screen
}


// You can use this timer only if you learn how it works
void Timer2_Init(unsigned long period){ 
  unsigned long volatile delay;
  SYSCTL_RCGCTIMER_R |= 0x04;   // 0) activate timer2
  delay = SYSCTL_RCGCTIMER_R;
  TimerCount = 0;
  Semaphore = 0;
  TIMER2_CTL_R = 0x00000000;    // 1) disable timer2A during setup
  TIMER2_CFG_R = 0x00000000;    // 2) configure for 32-bit mode
  TIMER2_TAMR_R = 0x00000002;   // 3) configure for periodic mode, default down-count settings
  TIMER2_TAILR_R = period-1;    // 4) reload value
  TIMER2_TAPR_R = 0;            // 5) bus clock resolution
  TIMER2_ICR_R = 0x00000001;    // 6) clear timer2A timeout flag
  TIMER2_IMR_R = 0x00000001;    // 7) arm timeout interrupt
  NVIC_PRI5_R = (NVIC_PRI5_R&0x00FFFFFF)|0x80000000; // 8) priority 4
// interrupts enabled in the main program after all devices initialized
// vector number 39, interrupt number 23
  NVIC_EN0_R = 1<<23;           // 9) enable IRQ 23 in NVIC
  TIMER2_CTL_R = 0x00000001;    // 10) enable timer2A
}
void Timer2A_Handler(void){ 
  TIMER2_ICR_R = 0x00000001;   // acknowledge timer2A timeout
  TimerCount++;
  //////////////////////////////////////////////////////Move(); 
  Semaphore = 1; // trigger
}
void Delay100ms(unsigned long count){unsigned long volatile time;
  while(count>0){
    time = 727240;  // 0.1sec at 80 MHz
    while(time){
	  	time--;
    }
    count--;
  }
}
void Delay100msd(unsigned long count){unsigned long volatile time;
  while(count>0){
    time = 72724/2;  // 0.1sec at 80 MHz
    while(time){
	  	time--;
    }
    count--;
  }
}
void PortF_Init(void){ volatile unsigned long delay;
  SYSCTL_RCGC2_R |= 0x00000020;     // 1) F clock
  delay = SYSCTL_RCGC2_R;           // delay   
  GPIO_PORTF_LOCK_R = 0x4C4F434B;   // 2) unlock PortF PF0  
  GPIO_PORTF_CR_R = 0x1F;           // allow changes to PF4-0       
  GPIO_PORTF_AMSEL_R = 0x00;        // 3) disable analog function
  GPIO_PORTF_PCTL_R = 0x00000000;   // 4) GPIO clear bit PCTL  
  GPIO_PORTF_DIR_R = 0x0E;          // 5) PF4,PF0 input, PF3,PF2,PF1 output   
  GPIO_PORTF_AFSEL_R = 0x00;        // 6) no alternate function
  GPIO_PORTF_PUR_R = 0x11;          // enable pullup resistors on PF4,PF0       
  GPIO_PORTF_DEN_R = 0x1F;          // 7) enable digital pins PF4-PF0        
}

/*********PortE init*************/

void PortE_Init(void) {
    volatile unsigned long delay;
    SYSCTL_RCGC2_R |=  0x10;     // 1) activate clock for Port F
    delay = SYSCTL_RCGC2_R;           // allow time for clock to start
    GPIO_PORTE_AMSEL_R = 0x00;        // 3) disable analog on PF
    GPIO_PORTE_PCTL_R = 0x00000000;   // 4) PCTL GPIO on PF4-0
    GPIO_PORTE_DIR_R = 0x00;          // 5)
    GPIO_PORTE_AFSEL_R = 0x00;        // 6) disable alt funct on PF7-0
    GPIO_PORTE_PUR_R = 0x00;          // pull up disabled
    GPIO_PORTE_DEN_R = 0x1F;          // 7) enable digital I/O
}  

